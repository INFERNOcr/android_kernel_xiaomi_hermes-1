## drivers/misc/mediatek/accelerometer/lsm6ds3/Kconfig
```kconfig
config MTK_BMI160_ACC

	bool "BMI160_ACC for MediaTek package"
	default n
	help
	  It support different accelerometer sensor.
          If this option is set,
	  it will support
          LSM6DS3_ACCEL Accelerometer.
```
